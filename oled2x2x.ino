// OLED Dashboard - 48x48 heart + header
// Adafruit Feather ESP32-S3 | SDA=3 SCL=4 OLED=0x3C
#include <WiFi.h>
#include <time.h>
#include <Wire.h>
#include <Adafruit_GFX.h>
#include <Adafruit_SSD1306.h>
#include <Adafruit_MAX1704X.h>
#include <Adafruit_NeoPixel.h>
#include <Adafruit_SHT4x.h>
#define SCREEN_WIDTH 128
#define SCREEN_HEIGHT 64
#define OLED_RESET -1
#define OLED_ADDR 0x3C
#define SDA_PIN 3
#define SCL_PIN 4
#define HEADER_H 16
#define LED_BRIGHTNESS 35
#define FRAME_DELAY 42
#define FRAME_WIDTH 48
#define FRAME_HEIGHT 48
#define LOW_BATTERY_PERCENT 5
const byte PROGMEM frames[][288] = {
  {0,0,0,0,0,0,0,0,0,0,0,0,0,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0,0},
  {0,0,0,0,0,0,0,0,0,0,0,0,0,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0,0},
  {0,0,0,0,0,0,0,0,0,0,0,0,0,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0,0},
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  {0,0,0,0,0,0,0,0,0,0,0,0,0,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0,0}
};
#define FRAME_COUNT (sizeof(frames)/sizeof(frames[0]))
Adafruit_SSD1306 display(SCREEN_WIDTH, SCREEN_HEIGHT, &Wire, OLED_RESET);
Adafruit_MAX17048 maxlipo;
Adafruit_NeoPixel pixel(1, PIN_NEOPIXEL, NEO_GRB + NEO_KHZ800);
Adafruit_SHT4x sht4;
const char* WIFI_SSID = "YOUR_SSID";
const char* WIFI_PASS = "YOUR_PASSWORD";
const char* TZ_INFO = "EST5EDT,M3.2.0,M11.1.0";
const char* NTP1 = "pool.ntp.org";
const char* NTP2 = "time.nist.gov";
const char* NTP3 = "time.google.com";
bool batteryOK=false; int batteryPercent=-1; float batteryVoltage=-1.0f;
bool timeReady=false, wifiConnected=false, wifiConnecting=false;
bool sht4OK=false; float lastTempF=-999.0f; float lastHumidity=-999.0f;
int screenMode=0; // 0=GIF, 1=clock, 2=temp/humidity
int heartFrame=0;
unsigned long lastBatteryRead=0, lastNtpSyncMs=0, lastDrawMs=0, lastReconnectAttempt=0, lastScreenSwitch=0, lastSensorRead=0;
const unsigned long BATTERY_READ_INTERVAL_MS=10000UL;
const unsigned long NTP_RESYNC_INTERVAL_MS=6UL*60UL*60UL*1000UL;
const unsigned long DRAW_INTERVAL_MS=FRAME_DELAY;
const unsigned long WIFI_RETRY_INTERVAL_MS=10000UL;
const unsigned long SCREEN_SWITCH_INTERVAL_MS=7000UL;
const unsigned long SENSOR_READ_INTERVAL_MS=5000UL;
void enableI2CPower(){
#ifdef PIN_I2C_POWER
  pinMode(PIN_I2C_POWER,OUTPUT); digitalWrite(PIN_I2C_POWER,HIGH);
#endif
}
void enableNeoPixelPower(){
#ifdef NEOPIXEL_POWER
  pinMode(NEOPIXEL_POWER,OUTPUT); digitalWrite(NEOPIXEL_POWER,HIGH);
#endif
}
void centerText(const String& t,int y,int s){
  int16_t x1,y1; uint16_t w,h;
  display.setTextSize(s);
  display.getTextBounds(t,0,y,&x1,&y1,&w,&h);
  display.setCursor((SCREEN_WIDTH-(int)w)/2,y);
  display.print(t);
}
void setPixel(uint8_t r,uint8_t g,uint8_t b){pixel.setPixelColor(0,pixel.Color(r,g,b));pixel.show();}
void updateStatusLED(){
  unsigned long now=millis();
  if(wifiConnecting){setPixel(10,5,0);return;}
  if(wifiConnected&&timeReady){
    if((now%5000UL)<120UL)setPixel(0,10,0);else setPixel(0,0,0);return;
  }
  if(wifiConnected&&!timeReady){
    if((now%1000UL)<150UL)setPixel(0,0,10);else setPixel(0,0,0);return;
  }
  if((now%1200UL)<180UL)setPixel(10,0,0);else setPixel(0,0,0);
}
void drawBatteryIcon(int x,int y,int w,int h,int pct){
  display.drawRect(x,y,w,h,SSD1306_WHITE);
  int th=h/2,ty=y+(h-th)/2;
  display.fillRect(x+w,ty,3,th,SSD1306_WHITE);
  int ix=x+2,iy=y+2,iw=w-4,ih=h-4;
  if(pct<0){
    display.drawLine(ix,iy,ix+iw-1,iy+ih-1,SSD1306_WHITE);
    display.drawLine(ix+iw-1,iy,ix,iy+ih-1,SSD1306_WHITE);
    return;
  }
  int fw=(iw*constrain(pct,0,100))/100;
  if(fw>0)display.fillRect(ix,iy,fw,ih,SSD1306_WHITE);
}
void drawWifiStatus(int x,int y){
  display.setTextSize(1);display.setCursor(x,y);display.print("WiFi");
  int bx=x+30,by=y-1;
  display.drawRect(bx,by,10,10,SSD1306_WHITE);
  if(wifiConnected){
    display.drawLine(bx+2,by+5,bx+4,by+7,SSD1306_WHITE);
    display.drawLine(bx+4,by+7,bx+7,by+3,SSD1306_WHITE);
  }else if(wifiConnecting){
    display.fillCircle(bx+5,by+5,2,SSD1306_WHITE);
  }else{
    display.drawLine(bx+2,by+2,bx+7,by+7,SSD1306_WHITE);
    display.drawLine(bx+7,by+2,bx+2,by+7,SSD1306_WHITE);
  }
}
bool isLowBattery(){return(batteryPercent>=0&&batteryPercent<=LOW_BATTERY_PERCENT);}
void refreshBattery(){
  if(!batteryOK)return;
  float p=maxlipo.cellPercent(),v=maxlipo.cellVoltage();
  batteryPercent=isnan(p)?-1:constrain((int)(p+0.5f),0,100);
  batteryVoltage=isnan(v)?-1.0f:v;
}
void refreshSensor(){
  if(!sht4OK)return;
  sensors_event_t humidity,temp;
  sht4.getEvent(&humidity,&temp);
  lastTempF=(temp.temperature*9.0f/5.0f)+32.0f;
  lastHumidity=humidity.relative_humidity;
}
bool connectWiFi(unsigned long ms=15000){
  wifiConnecting=true;wifiConnected=false;updateStatusLED();
  WiFi.mode(WIFI_STA);WiFi.disconnect();delay(100);
  WiFi.begin(WIFI_SSID,WIFI_PASS);
  unsigned long t=millis();
  while(millis()-t<ms){
    if(WiFi.status()==WL_CONNECTED){wifiConnected=true;wifiConnecting=false;updateStatusLED();return true;}
    updateStatusLED();delay(200);
  }
  wifiConnected=false;wifiConnecting=false;updateStatusLED();return false;
}
bool syncTimeFromNTP(unsigned long ms=12000){
  configTzTime(TZ_INFO,NTP1,NTP2,NTP3);
  struct tm ti;
  unsigned long t=millis();
  while(millis()-t<ms){
    if(getLocalTime(&ti,200)){timeReady=true;lastNtpSyncMs=millis();updateStatusLED();return true;}
    updateStatusLED();delay(100);
  }
  return false;
}
void drawHeader(bool showClockTime=false){
  display.fillRect(0,0,SCREEN_WIDTH,HEADER_H,SSD1306_BLACK);
  display.setTextColor(SSD1306_WHITE);
  drawBatteryIcon(4,3,18,9,batteryPercent);
  if(showClockTime&&timeReady){
    struct tm ti;
    if(getLocalTime(&ti,20)){
      char timebuf[16];
      strftime(timebuf,sizeof(timebuf),"%I:%M:%S %p",&ti);
      if(timebuf[0]=='0')memmove(timebuf,timebuf+1,strlen(timebuf));
      int16_t x1,y1;uint16_t w,h;
      display.setTextSize(1);
      display.getTextBounds(timebuf,0,0,&x1,&y1,&w,&h);
      display.setCursor((SCREEN_WIDTH-(int)w)/2,4);
      display.print(timebuf);
    }
    int bx=SCREEN_WIDTH-12,by=3;
    display.drawRect(bx,by,10,10,SSD1306_WHITE);
    if(wifiConnected){
      display.drawLine(bx+2,by+5,bx+4,by+7,SSD1306_WHITE);
      display.drawLine(bx+4,by+7,bx+7,by+3,SSD1306_WHITE);
    }else if(wifiConnecting){
      display.fillCircle(bx+5,by+5,2,SSD1306_WHITE);
    }else{
      display.drawLine(bx+2,by+2,bx+7,by+7,SSD1306_WHITE);
      display.drawLine(bx+7,by+2,bx+2,by+7,SSD1306_WHITE);
    }
  }else{
    display.setTextSize(1);
    display.setCursor(28,2);
    if(batteryPercent>=0){display.print(batteryPercent);display.print("%");}
    else display.print("--%");
    drawWifiStatus(84,2);
  }
}
void drawHeartAnimation(){
  display.drawBitmap(40,HEADER_H,frames[heartFrame],FRAME_WIDTH,FRAME_HEIGHT,SSD1306_WHITE);
}
void drawTimeScreen(){
  if(!timeReady){centerText("No time",32,1);return;}
  struct tm ti;
  if(!getLocalTime(&ti,20)){centerText("No time",32,1);return;}
  char hm[6];strftime(hm,sizeof(hm),"%I:%M",&ti);
  if(hm[0]=='0'){memmove(hm,hm+1,sizeof(hm)-1);} // strip leading zero
  char sec[3];strftime(sec,sizeof(sec),"%S",&ti);
  char ampm[3];strftime(ampm,sizeof(ampm),"%p",&ti);
  int16_t x1,y1;uint16_t w,h;
  display.setTextSize(3);
  display.getTextBounds(hm,0,0,&x1,&y1,&w,&h);
  display.setCursor((SCREEN_WIDTH-(int)w)/2,19);
  display.setTextColor(SSD1306_WHITE);
  display.print(hm);
  display.setTextSize(1);
  char sub[8];snprintf(sub,sizeof(sub),":%s %s",sec,ampm);
  display.getTextBounds(sub,0,0,&x1,&y1,&w,&h);
  display.setCursor((SCREEN_WIDTH-(int)w)/2,46);
  display.print(sub);
}
void drawLowBatteryWarning(){
  display.setTextColor(SSD1306_WHITE);
  centerText("LOW",22,2);centerText("BATTERY",40,2);
  if(batteryPercent>=0)centerText(String(batteryPercent)+"%",56,1);
  else centerText("CHARGE SOON",56,1);
}
void drawTempHumidScreen(){
  display.setTextColor(SSD1306_WHITE);
  centerText("INDOOR",18,1);
  if(!sht4OK){
    centerText("No sensor",34,1);return;
  }
  if(lastTempF<-998.0f){
    centerText("Reading...",34,1);return;
  }
  char tempStr[10];
  dtostrf(lastTempF,4,1,tempStr);
  int16_t x1,y1;uint16_t numW,numH,fW,fH;
  display.setTextSize(2);
  display.getTextBounds(tempStr,0,0,&x1,&y1,&numW,&numH);
  display.getTextBounds("F",0,0,&x1,&y1,&fW,&fH);
  const int degGap=8; // pixels reserved for degree circle + spacing
  int totalW=(int)numW+degGap+(int)fW;
  int sx=(SCREEN_WIDTH-totalW)/2;
  const int ty=27;
  display.setCursor(sx,ty);
  display.print(tempStr);
  // draw degree circle (avoids unsupported \xb0 glyph)
  display.drawCircle(sx+(int)numW+3,ty+3,2,SSD1306_WHITE);
  display.setCursor(sx+(int)numW+degGap,ty);
  display.print("F");
  char humStr[14];
  snprintf(humStr,sizeof(humStr),"Hum: %.0f%%",lastHumidity);
  uint16_t humW,humH;
  display.setTextSize(1);
  display.getTextBounds(humStr,0,0,&x1,&y1,&humW,&humH);
  display.setCursor((SCREEN_WIDTH-(int)humW)/2,50);
  display.print(humStr);
}
void drawScreen(){
  display.clearDisplay();drawHeader(screenMode==0);
  if(isLowBattery())drawLowBatteryWarning();
  else if(screenMode==1)drawTimeScreen();
  else if(screenMode==2)drawTempHumidScreen();
  else{drawHeartAnimation();heartFrame=(heartFrame+1)%FRAME_COUNT;}
  display.display();
}
void setup(){
  Serial.begin(115200);delay(1000);
  enableI2CPower();enableNeoPixelPower();
  pixel.begin();pixel.setBrightness(LED_BRIGHTNESS);setPixel(0,0,0);
  Wire.begin(SDA_PIN,SCL_PIN);
  if(!display.begin(SSD1306_SWITCHCAPVCC,OLED_ADDR)){
    while(true){setPixel(10,0,0);delay(100);setPixel(0,0,0);delay(100);}
  }
  display.clearDisplay();display.display();
  batteryOK=maxlipo.begin(&Wire);
  if(batteryOK){maxlipo.quickStart();delay(250);refreshBattery();}
  sht4OK=sht4.begin(&Wire);
  if(sht4OK){sht4.setPrecision(SHT4X_HIGH_PRECISION);refreshSensor();}
  display.clearDisplay();display.setTextColor(SSD1306_WHITE);
  centerText("Connecting",16,1);centerText("WiFi...",32,2);display.display();
  connectWiFi();
  if(wifiConnected)syncTimeFromNTP();
  drawScreen();updateStatusLED();
}
void loop(){
  unsigned long now=millis();
  wifiConnected=(WiFi.status()==WL_CONNECTED);
  if(now-lastScreenSwitch>=SCREEN_SWITCH_INTERVAL_MS){lastScreenSwitch=now;screenMode=(screenMode+1)%3;}
  if(!wifiConnected&&!wifiConnecting&&(now-lastReconnectAttempt>=WIFI_RETRY_INTERVAL_MS)){
    lastReconnectAttempt=now;connectWiFi(8000);
    if(wifiConnected)syncTimeFromNTP(5000);
  }
  if(now-lastBatteryRead>=BATTERY_READ_INTERVAL_MS){lastBatteryRead=now;refreshBattery();}
  if(now-lastSensorRead>=SENSOR_READ_INTERVAL_MS){lastSensorRead=now;refreshSensor();}
  if(wifiConnected&&(!timeReady||(now-lastNtpSyncMs>=NTP_RESYNC_INTERVAL_MS)))syncTimeFromNTP(5000);
  if(now-lastDrawMs>=DRAW_INTERVAL_MS){lastDrawMs=now;drawScreen();}
  updateStatusLED();
  delay(10);
}
