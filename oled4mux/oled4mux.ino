// OLED Dashboard - 4x screens via TCA9548A I2C multiplexer (SD0–SD3)
// Adafruit Feather ESP32-S3 | SDA=GPIO3  SCL=GPIO4 | OLED=0x3C | TCA9548A=0x70
//
// Wiring:
//   Feather STEMMA QT (Qwiic) port
//     → Qwiic cable to TCA9548A breakout
//       → SD0 channel wires → OLED screen 0
//       → SD1 channel wires → OLED screen 1
//       → SD2 channel wires → OLED screen 2
//       → SD3 channel wires → OLED screen 3
//
// Notes:
//   - STEMMA QT on the Feather ESP32-S3 shares Wire (SDA=GPIO3, SCL=GPIO4)
//     with the header pins — no pin change needed.
//   - PIN_I2C_POWER is driven HIGH by enableI2CPower() to power the STEMMA QT rail.
//   - TCA9548A address pins A0/A1/A2 must all be tied LOW for address 0x70.
//   - MAX17048 (battery) and SHT4x (sensor) connect directly on the main I2C
//     bus (not behind the mux), e.g. via a Qwiic T/splitter or header pins.
//
// Screen layout:
//   Channel 0 (SD0): Heart animation GIF
//   Channel 1 (SD1): Clock / time
//   Channel 2 (SD2): Temperature & humidity
//   Channel 3 (SD3): Battery & WiFi status

#include <WiFi.h>
#include <time.h>
#include <Wire.h>
#include <Adafruit_GFX.h>
#include <Adafruit_SSD1306.h>
#include <Adafruit_MAX1704X.h>
#include <Adafruit_NeoPixel.h>
#include <Adafruit_SHT4x.h>
#include "esp_sleep.h"

#define SCREEN_WIDTH   128
#define SCREEN_HEIGHT   64
#define OLED_RESET      -1
#define OLED_ADDR     0x3C
#define TCA_ADDR      0x70   // TCA9548A default address (A0/A1/A2 all LOW)
#define SDA_PIN           3
#define SCL_PIN           4
#define NUM_SCREENS       4

#define HEADER_H         16
#define LED_BRIGHTNESS   35
#define FRAME_DELAY      42
#define FRAME_WIDTH      48
#define FRAME_HEIGHT     48
#define LOW_BATTERY_PERCENT 5

// Photoresistor on A0 — voltage divider: LDR from 3.3V to A0, 10kΩ from A0 to GND
// Bright light → high ADC → high contrast. Dark → low ADC → low contrast.
//
// HOW TO CALIBRATE:
//   1. Flash and open Serial Monitor (115200 baud)
//   2. Cover the LDR completely — note the "LDR raw=" value → set LDR_DARK_RAW
//   3. Shine a bright light at it — note the value → set LDR_BRIGHT_RAW
//   4. Reflash. Screens will now span the full contrast range across your real environment.
#define LDR_PIN              A0
#define LDR_DARK_RAW          0   // ADC at/below this → screens off (0 = disabled until calibrated)
#define LDR_BRIGHT_RAW     1000   // ADC at/above this → full brightness
#define LDR_MIN_CONTRAST      0   // contrast at/below dark threshold (off)
#define LDR_MAX_CONTRAST    220   // contrast at/above bright threshold
#define LDR_READ_INTERVAL_MS 100UL // how often to sample (ms)
#define LDR_DEADBAND          5   // ignore changes smaller than this
#define LDR_SLEEP_DURATION_US (5ULL * 1000000ULL) // light-sleep check interval when dark


const byte PROGMEM frames[][288] = {
  {0,0,0,0,0,0,0,0,0,0,0,0,0,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0,0},
  {0,0,0,0,0,0,0,0,0,0,0,0,0,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0,0},
  {0,0,0,0,0,0,0,0,0,0,0,0,0,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0,0},
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  {0,0,0,0,0,0,0,0,0,0,0,0,0,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0,0}
};
#define FRAME_COUNT (sizeof(frames)/sizeof(frames[0]))

// Single shared display object — channel is switched via TCA9548A before each use
Adafruit_SSD1306 display(SCREEN_WIDTH, SCREEN_HEIGHT, &Wire, OLED_RESET);
Adafruit_MAX17048 maxlipo;
Adafruit_NeoPixel pixel(1, PIN_NEOPIXEL, NEO_GRB + NEO_KHZ800);
Adafruit_SHT4x sht4;

const char* WIFI_SSID = "YOUR_SSID";
const char* WIFI_PASS = "YOUR_PASSWORD";
const char* TZ_INFO   = "EST5EDT,M3.2.0,M11.1.0";
const char* NTP1      = "pool.ntp.org";
const char* NTP2      = "time.nist.gov";
const char* NTP3      = "time.google.com";

bool batteryOK = false;
int  batteryPercent = -1;
float batteryVoltage = -1.0f;
bool timeReady = false, wifiConnected = false, wifiConnecting = false;
bool sht4OK = false;
float lastTempF = -999.0f, lastHumidity = -999.0f;
int heartFrame = 0;

unsigned long lastBatteryRead = 0, lastNtpSyncMs = 0, lastDrawMs = 0;
unsigned long lastReconnectAttempt = 0, lastSensorRead = 0, lastLdrRead = 0;
uint8_t currentContrast = LDR_MAX_CONTRAST;
bool    screenSleeping  = false;  // true while in dark-triggered light sleep

const unsigned long BATTERY_READ_INTERVAL_MS  = 10000UL;
const unsigned long NTP_RESYNC_INTERVAL_MS    = 6UL * 60UL * 60UL * 1000UL;
const unsigned long DRAW_INTERVAL_MS          = FRAME_DELAY;
const unsigned long WIFI_RETRY_INTERVAL_MS    = 10000UL;
const unsigned long SENSOR_READ_INTERVAL_MS   = 5000UL;

// ---------------------------------------------------------------------------
// Photoresistor / auto-brightness
// ---------------------------------------------------------------------------

// Send SSD1306 contrast command to all 4 screens without redrawing.
void setAllContrast(uint8_t contrast) {
  for (uint8_t ch = 0; ch < NUM_SCREENS; ch++) {
    tcaSelect(ch);
    display.ssd1306_command(SSD1306_SETCONTRAST);
    display.ssd1306_command(contrast);
  }
  tcaDisable();
}

void updateBrightness() {
  int raw = analogRead(LDR_PIN);
  int clamped = constrain(raw, LDR_DARK_RAW, LDR_BRIGHT_RAW);
  uint8_t target = (uint8_t)map(clamped, LDR_DARK_RAW, LDR_BRIGHT_RAW,
                                 LDR_MIN_CONTRAST, LDR_MAX_CONTRAST);
  Serial.printf("LDR raw=%4d  contrast=%3d\n", raw, target);
  if (abs((int)target - (int)currentContrast) > LDR_DEADBAND) {
    currentContrast = target;
    setAllContrast(currentContrast);
  }
}

// ---------------------------------------------------------------------------
// TCA9548A multiplexer helpers
// ---------------------------------------------------------------------------

// Select a single channel (0–3). Call before any display or sensor I2C op.
void tcaSelect(uint8_t ch) {
  Wire.beginTransmission(TCA_ADDR);
  Wire.write(ch < 8 ? (1 << ch) : 0);  // 0 disables all channels
  Wire.endTransmission();
}

// Disable all mux channels (idle state)
void tcaDisable() {
  Wire.beginTransmission(TCA_ADDR);
  Wire.write(0x00);
  Wire.endTransmission();
}

// ---------------------------------------------------------------------------
// Hardware helpers
// ---------------------------------------------------------------------------

void enableI2CPower() {
#ifdef PIN_I2C_POWER
  pinMode(PIN_I2C_POWER, OUTPUT);
  digitalWrite(PIN_I2C_POWER, HIGH);
#endif
}

void enableNeoPixelPower() {
#ifdef NEOPIXEL_POWER
  pinMode(NEOPIXEL_POWER, OUTPUT);
  digitalWrite(NEOPIXEL_POWER, HIGH);
#endif
}

void setPixel(uint8_t r, uint8_t g, uint8_t b) {
  pixel.setPixelColor(0, pixel.Color(r, g, b));
  pixel.show();
}

void updateStatusLED() {
  unsigned long now = millis();
  if (wifiConnecting)               { setPixel(10, 5, 0); return; }
  if (wifiConnected && timeReady)   {
    if ((now % 5000UL) < 120UL) setPixel(0, 10, 0); else setPixel(0, 0, 0);
    return;
  }
  if (wifiConnected && !timeReady)  {
    if ((now % 1000UL) < 150UL) setPixel(0, 0, 10); else setPixel(0, 0, 0);
    return;
  }
  if ((now % 1200UL) < 180UL) setPixel(10, 0, 0); else setPixel(0, 0, 0);
}

// ---------------------------------------------------------------------------
// Draw helpers (operate on whatever channel is currently active)
// ---------------------------------------------------------------------------

void centerText(const String& t, int y, int s) {
  int16_t x1, y1; uint16_t w, h;
  display.setTextSize(s);
  display.getTextBounds(t, 0, y, &x1, &y1, &w, &h);
  display.setCursor((SCREEN_WIDTH - (int)w) / 2, y);
  display.print(t);
}

void drawBatteryIcon(int x, int y, int w, int h, int pct) {
  display.drawRect(x, y, w, h, SSD1306_WHITE);
  int th = h / 2, ty = y + (h - th) / 2;
  display.fillRect(x + w, ty, 3, th, SSD1306_WHITE);
  int ix = x + 2, iy = y + 2, iw = w - 4, ih = h - 4;
  if (pct < 0) {
    display.drawLine(ix, iy, ix + iw - 1, iy + ih - 1, SSD1306_WHITE);
    display.drawLine(ix + iw - 1, iy, ix, iy + ih - 1, SSD1306_WHITE);
    return;
  }
  int fw = (iw * constrain(pct, 0, 100)) / 100;
  if (fw > 0) display.fillRect(ix, iy, fw, ih, SSD1306_WHITE);
}

void drawWifiCheck(int bx, int by) {
  display.drawRect(bx, by, 10, 10, SSD1306_WHITE);
  if (wifiConnected) {
    display.drawLine(bx + 2, by + 5, bx + 4, by + 7, SSD1306_WHITE);
    display.drawLine(bx + 4, by + 7, bx + 7, by + 3, SSD1306_WHITE);
  } else if (wifiConnecting) {
    display.fillCircle(bx + 5, by + 5, 2, SSD1306_WHITE);
  } else {
    display.drawLine(bx + 2, by + 2, bx + 7, by + 7, SSD1306_WHITE);
    display.drawLine(bx + 7, by + 2, bx + 2, by + 7, SSD1306_WHITE);
  }
}

void drawHeader(bool showTime) {
  display.fillRect(0, 0, SCREEN_WIDTH, HEADER_H, SSD1306_BLACK);
  display.setTextColor(SSD1306_WHITE);
  drawBatteryIcon(4, 3, 18, 9, batteryPercent);
  if (showTime && timeReady) {
    struct tm ti;
    if (getLocalTime(&ti, 20)) {
      char buf[16];
      strftime(buf, sizeof(buf), "%I:%M:%S %p", &ti);
      if (buf[0] == '0') memmove(buf, buf + 1, strlen(buf));
      int16_t x1, y1; uint16_t w, h;
      display.setTextSize(1);
      display.getTextBounds(buf, 0, 0, &x1, &y1, &w, &h);
      display.setCursor((SCREEN_WIDTH - (int)w) / 2, 4);
      display.print(buf);
    }
    drawWifiCheck(SCREEN_WIDTH - 12, 3);
  } else {
    display.setTextSize(1);
    display.setCursor(28, 2);
    if (batteryPercent >= 0) { display.print(batteryPercent); display.print("%"); }
    else display.print("--%");
    display.setTextSize(1);
    display.setCursor(80, 2);
    display.print("WiFi");
    drawWifiCheck(SCREEN_WIDTH - 12, 3);
  }
}

bool isLowBattery() { return (batteryPercent >= 0 && batteryPercent <= LOW_BATTERY_PERCENT); }

// ---------------------------------------------------------------------------
// Per-screen draw functions
// ---------------------------------------------------------------------------

// Screen 0 (SD0): Animated heart GIF
void drawScreen0() {
  display.clearDisplay();
  drawHeader(false);
  if (isLowBattery()) {
    display.setTextColor(SSD1306_WHITE);
    centerText("LOW",    22, 2);
    centerText("BATTERY",40, 2);
    if (batteryPercent >= 0) centerText(String(batteryPercent) + "%", 56, 1);
  } else {
    display.drawBitmap(40, HEADER_H, frames[heartFrame], FRAME_WIDTH, FRAME_HEIGHT, SSD1306_WHITE);
    heartFrame = (heartFrame + 1) % FRAME_COUNT;
  }
  display.display();
}

// Screen 1 (SD1): Clock
void drawScreen1() {
  display.clearDisplay();
  drawHeader(true);
  display.setTextColor(SSD1306_WHITE);
  if (!timeReady) {
    centerText("No time", 32, 1);
  } else {
    struct tm ti;
    if (!getLocalTime(&ti, 20)) {
      centerText("No time", 32, 1);
    } else {
      char hm[6]; strftime(hm, sizeof(hm), "%I:%M", &ti);
      if (hm[0] == '0') memmove(hm, hm + 1, sizeof(hm) - 1);
      char sec[3];  strftime(sec,  sizeof(sec),  "%S",  &ti);
      char ampm[3]; strftime(ampm, sizeof(ampm), "%p",  &ti);

      int16_t x1, y1; uint16_t w, h;
      display.setTextSize(3);
      display.getTextBounds(hm, 0, 0, &x1, &y1, &w, &h);
      display.setCursor((SCREEN_WIDTH - (int)w) / 2, 19);
      display.print(hm);

      char sub[8]; snprintf(sub, sizeof(sub), ":%s %s", sec, ampm);
      display.setTextSize(1);
      display.getTextBounds(sub, 0, 0, &x1, &y1, &w, &h);
      display.setCursor((SCREEN_WIDTH - (int)w) / 2, 46);
      display.print(sub);

      // date line
      char datebuf[16]; strftime(datebuf, sizeof(datebuf), "%a %b %d", &ti);
      display.getTextBounds(datebuf, 0, 0, &x1, &y1, &w, &h);
      display.setCursor((SCREEN_WIDTH - (int)w) / 2, 56);
      display.print(datebuf);
    }
  }
  display.display();
}

// Screen 2 (SD2): Temperature & Humidity
void drawScreen2() {
  display.clearDisplay();
  drawHeader(false);
  display.setTextColor(SSD1306_WHITE);
  centerText("INDOOR", 18, 1);
  if (!sht4OK) {
    centerText("No sensor", 34, 1);
  } else if (lastTempF < -998.0f) {
    centerText("Reading...", 34, 1);
  } else {
    char tempStr[10]; dtostrf(lastTempF, 4, 1, tempStr);
    int16_t x1, y1; uint16_t numW, numH, fW, fH;
    display.setTextSize(2);
    display.getTextBounds(tempStr, 0, 0, &x1, &y1, &numW, &numH);
    display.getTextBounds("F", 0, 0, &x1, &y1, &fW, &fH);
    const int degGap = 8;
    int totalW = (int)numW + degGap + (int)fW;
    int sx = (SCREEN_WIDTH - totalW) / 2;
    const int ty = 27;
    display.setCursor(sx, ty); display.print(tempStr);
    display.drawCircle(sx + (int)numW + 3, ty + 3, 2, SSD1306_WHITE);
    display.setCursor(sx + (int)numW + degGap, ty); display.print("F");

    char humStr[14]; snprintf(humStr, sizeof(humStr), "Hum: %.0f%%", lastHumidity);
    uint16_t humW, humH;
    display.setTextSize(1);
    display.getTextBounds(humStr, 0, 0, &x1, &y1, &humW, &humH);
    display.setCursor((SCREEN_WIDTH - (int)humW) / 2, 50);
    display.print(humStr);
  }
  display.display();
}

// Screen 3 (SD3): Battery & WiFi status
void drawScreen3() {
  display.clearDisplay();
  display.setTextColor(SSD1306_WHITE);

  // Large battery icon (centered, full-width)
  const int bx = 8, by = 4, bw = 96, bh = 28;
  display.drawRect(bx, by, bw, bh, SSD1306_WHITE);
  int tipH = bh / 2, tipY = by + (bh - tipH) / 2;
  display.fillRect(bx + bw, tipY, 5, tipH, SSD1306_WHITE);
  int fill = (batteryPercent >= 0) ? ((bw - 6) * constrain(batteryPercent, 0, 100)) / 100 : 0;
  if (fill > 0) display.fillRect(bx + 3, by + 3, fill, bh - 6, SSD1306_WHITE);
  if (batteryPercent < 0) {
    display.drawLine(bx + 3, by + 3, bx + bw - 4, by + bh - 4, SSD1306_WHITE);
    display.drawLine(bx + bw - 4, by + 3, bx + 3, by + bh - 4, SSD1306_WHITE);
  }

  // Percentage + voltage
  display.setTextSize(2);
  char pctStr[8];
  if (batteryPercent >= 0) snprintf(pctStr, sizeof(pctStr), "%d%%", batteryPercent);
  else strncpy(pctStr, "--%%", sizeof(pctStr));
  // Invert text color so it reads white-on-black inside the filled bar
  int16_t x1, y1; uint16_t w, h;
  display.getTextBounds(pctStr, 0, 0, &x1, &y1, &w, &h);
  display.setCursor((SCREEN_WIDTH - (int)w) / 2, by + (bh - (int)h) / 2);
  display.setTextColor(SSD1306_BLACK, SSD1306_WHITE);
  display.print(pctStr);
  display.setTextColor(SSD1306_WHITE);

  // Voltage line
  display.setTextSize(1);
  char vStr[16];
  if (batteryVoltage > 0.0f) snprintf(vStr, sizeof(vStr), "%.2fV", batteryVoltage);
  else strncpy(vStr, "-.--V", sizeof(vStr));
  display.setCursor(bx, by + bh + 4);
  display.print(vStr);

  // WiFi status
  const char* wfLabel = wifiConnected ? "WiFi: OK" : (wifiConnecting ? "WiFi: ..." : "WiFi: OFF");
  display.getTextBounds(wfLabel, 0, 0, &x1, &y1, &w, &h);
  display.setCursor(SCREEN_WIDTH - (int)w - 4, by + bh + 4);
  display.print(wfLabel);

  // IP address (if connected)
  if (wifiConnected) {
    String ip = WiFi.localIP().toString();
    display.getTextBounds(ip.c_str(), 0, 0, &x1, &y1, &w, &h);
    display.setCursor((SCREEN_WIDTH - (int)w) / 2, 46);
    display.print(ip);
  }

  // LDR debug row: raw ADC + current contrast level
  int ldrRaw = analogRead(LDR_PIN);
  char ldrStr[24];
  snprintf(ldrStr, sizeof(ldrStr), "LDR:%4d  Brt:%3d", ldrRaw, currentContrast);
  display.setTextSize(1);
  display.setCursor(0, 56);
  display.print(ldrStr);

  display.display();
}

// ---------------------------------------------------------------------------
// Sensor / network helpers
// ---------------------------------------------------------------------------

void refreshBattery() {
  if (!batteryOK) return;
  float p = maxlipo.cellPercent(), v = maxlipo.cellVoltage();
  batteryPercent  = isnan(p) ? -1 : constrain((int)(p + 0.5f), 0, 100);
  batteryVoltage  = isnan(v) ? -1.0f : v;
}

void refreshSensor() {
  if (!sht4OK) return;
  sensors_event_t humidity, temp;
  sht4.getEvent(&humidity, &temp);
  lastTempF    = (temp.temperature * 9.0f / 5.0f) + 32.0f;
  lastHumidity = humidity.relative_humidity;
}

bool connectWiFi(unsigned long ms = 15000) {
  wifiConnecting = true; wifiConnected = false; updateStatusLED();
  WiFi.mode(WIFI_STA); WiFi.disconnect(); delay(100);
  WiFi.begin(WIFI_SSID, WIFI_PASS);
  unsigned long t = millis();
  while (millis() - t < ms) {
    if (WiFi.status() == WL_CONNECTED) {
      wifiConnected = true; wifiConnecting = false; updateStatusLED(); return true;
    }
    updateStatusLED(); delay(200);
  }
  wifiConnected = false; wifiConnecting = false; updateStatusLED(); return false;
}

bool syncTimeFromNTP(unsigned long ms = 12000) {
  configTzTime(TZ_INFO, NTP1, NTP2, NTP3);
  struct tm ti;
  unsigned long t = millis();
  while (millis() - t < ms) {
    if (getLocalTime(&ti, 200)) {
      timeReady = true; lastNtpSyncMs = millis(); updateStatusLED(); return true;
    }
    updateStatusLED(); delay(100);
  }
  return false;
}

// ---------------------------------------------------------------------------
// I2C / mux diagnostics  (results appear in Serial Monitor at 115200 baud)
// ---------------------------------------------------------------------------

// Scan the currently-active I2C bus and print every found address.
void i2cScan(const char* label) {
  Serial.printf("--- I2C scan: %s ---\n", label);
  int found = 0;
  for (uint8_t addr = 1; addr < 127; addr++) {
    Wire.beginTransmission(addr);
    if (Wire.endTransmission() == 0) {
      Serial.printf("  0x%02X", addr);
      if (addr == TCA_ADDR)  Serial.print("  <- TCA9548A mux");
      if (addr == OLED_ADDR) Serial.print("  <- SSD1306 OLED");
      if (addr == 0x36)      Serial.print("  <- MAX17048 battery gauge");
      if (addr == 0x44)      Serial.print("  <- SHT4x temp/humidity");
      Serial.println();
      found++;
    }
  }
  if (!found) Serial.println("  (nothing found)");
}

// Check the mux is present then scan each channel for the OLED.
void muxDiag() {
  Serial.println("=== TCA9548A / mux diagnostic ===");

  // 1. Check mux is reachable on main bus
  Wire.beginTransmission(TCA_ADDR);
  uint8_t err = Wire.endTransmission();
  if (err != 0) {
    Serial.printf("  ERROR: TCA9548A NOT found at 0x%02X (err=%d)\n", TCA_ADDR, err);
    Serial.println("  Check: power to breakout, SDA/SCL polarity, A0/A1/A2 all LOW");
    return;
  }
  Serial.printf("  TCA9548A OK at 0x%02X\n", TCA_ADDR);

  // 2. Per-channel OLED check
  for (uint8_t ch = 0; ch < NUM_SCREENS; ch++) {
    tcaSelect(ch);
    delay(5);
    Wire.beginTransmission(OLED_ADDR);
    err = Wire.endTransmission();
    Serial.printf("  SD%d: OLED 0x%02X %s\n",
                  ch, OLED_ADDR, err == 0 ? "OK" : "NOT FOUND (check wires / power)");
  }
  tcaDisable();
  Serial.println("=================================");
}

// Show a boot message on all 4 screens
void showBootMessage(const char* line1, const char* line2) {
  for (uint8_t ch = 0; ch < NUM_SCREENS; ch++) {
    tcaSelect(ch);
    display.clearDisplay();
    display.setTextColor(SSD1306_WHITE);
    centerText(line1, 16, 1);
    centerText(line2,  32, 2);
    display.display();
  }
}

// ---------------------------------------------------------------------------
// setup / loop
// ---------------------------------------------------------------------------

void setup() {
  Serial.begin(115200);
  delay(1000);

  enableI2CPower();
  enableNeoPixelPower();
  pixel.begin();
  pixel.setBrightness(LED_BRIGHTNESS);
  setPixel(0, 0, 0);

  Wire.begin(SDA_PIN, SCL_PIN);
  analogReadResolution(12);   // ESP32-S3: ensure full 12-bit ADC range
  pinMode(LDR_PIN, INPUT);

  // Run I2C diagnostics — read results in Serial Monitor
  i2cScan("main bus (before mux)");
  muxDiag();

  // Initialize all 4 displays through the TCA9548A
  for (uint8_t ch = 0; ch < NUM_SCREENS; ch++) {
    tcaSelect(ch);
    if (!display.begin(SSD1306_SWITCHCAPVCC, OLED_ADDR)) {
      Serial.printf("SSD1306 init failed on channel %d\n", ch);
      // Flash red and keep trying the remaining channels
      setPixel(10, 0, 0); delay(200); setPixel(0, 0, 0);
    } else {
      display.clearDisplay();
      display.display();
      Serial.printf("Screen %d OK\n", ch);
    }
  }
  tcaDisable();

  // Sensors (not behind the mux — on main I2C bus)
  batteryOK = maxlipo.begin(&Wire);
  if (batteryOK) { maxlipo.quickStart(); delay(250); refreshBattery(); }

  sht4OK = sht4.begin(&Wire);
  if (sht4OK) { sht4.setPrecision(SHT4X_HIGH_PRECISION); refreshSensor(); }

  showBootMessage("Connecting", "WiFi...");
  connectWiFi();
  if (wifiConnected) syncTimeFromNTP();

  // First full draw pass
  tcaSelect(0); drawScreen0();
  tcaSelect(1); drawScreen1();
  tcaSelect(2); drawScreen2();
  tcaSelect(3); drawScreen3();
  tcaDisable();

  updateStatusLED();
}

void loop() {
  unsigned long now = millis();

  wifiConnected = (WiFi.status() == WL_CONNECTED);

  if (!wifiConnected && !wifiConnecting && (now - lastReconnectAttempt >= WIFI_RETRY_INTERVAL_MS)) {
    lastReconnectAttempt = now;
    connectWiFi(8000);
    if (wifiConnected) syncTimeFromNTP(5000);
  }

  if (now - lastBatteryRead >= BATTERY_READ_INTERVAL_MS) {
    lastBatteryRead = now;
    refreshBattery();
  }

  if (now - lastSensorRead >= SENSOR_READ_INTERVAL_MS) {
    lastSensorRead = now;
    refreshSensor();
  }

  if (now - lastLdrRead >= LDR_READ_INTERVAL_MS) {
    lastLdrRead = now;
    updateBrightness();
  }

  // ── Light sleep when screens are off ──────────────────────────────────────
  if (currentContrast == 0) {
    if (!screenSleeping) {
      // First time going dark: drop WiFi to save power
      WiFi.disconnect(true);
      WiFi.mode(WIFI_OFF);
      wifiConnected = false;
      screenSleeping = true;
    }
    esp_sleep_enable_timer_wakeup(LDR_SLEEP_DURATION_US);
    esp_light_sleep_start();
    // Execution resumes here after timer wakeup.
    // Loop again immediately so updateBrightness() re-reads LDR.
    return;
  } else if (screenSleeping) {
    // Just came back from dark period — re-enable WiFi
    screenSleeping = false;
    WiFi.mode(WIFI_STA);
    lastReconnectAttempt = 0; // force immediate reconnect attempt
  }
  // ─────────────────────────────────────────────────────────────────────────

  if (wifiConnected && (!timeReady || (now - lastNtpSyncMs >= NTP_RESYNC_INTERVAL_MS))) {
    syncTimeFromNTP(5000);
  }

  if (now - lastDrawMs >= DRAW_INTERVAL_MS) {
    lastDrawMs = now;
    tcaSelect(0); drawScreen0();
    tcaSelect(1); drawScreen1();
    tcaSelect(2); drawScreen2();
    tcaSelect(3); drawScreen3();
    tcaDisable();
  }

  updateStatusLED();
  delay(10);
}
